## config/boards/shields/finger666/Kconfig.defconfig
```kconfig
if SHIELD_FINGER666_LEFT

config ZMK_KEYBOARD_NAME
    default "Finger666"

config ZMK_SPLIT_ROLE_CENTRAL
    default y

endif

if SHIELD_FINGER666_LEFT || SHIELD_FINGER666_RIGHT

config ZMK_SPLIT
    default y

endif
```

## config/boards/shields/finger666/Kconfig.shield
```kconfig
config SHIELD_FINGER666_LEFT
    def_bool $(shields_list_contains,finger666_left)

config SHIELD_FINGER666_RIGHT
    def_bool $(shields_list_contains,finger666_right)
```
